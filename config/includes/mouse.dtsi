#define ZMK_POINTING_DEFAULT_MOVE_VAL 1200  // default: 600
#define ZMK_POINTING_DEFAULT_SCRL_VAL 100   // default: 10
#include <dt-bindings/zmk/pointing.h>
#include <input/processors.dtsi>

&mmv {
    acceleration-exponent = <1>;      // 1
    time-to-max-speed-ms = <500>;     // 300
    trigger-period-ms = <16>;
};

&msc {
    acceleration-exponent = <0>;      // 0
    time-to-max-speed-ms = <120>;     // 300
    trigger-period-ms = <16>;
};

&mmv_input_listener {
    input-processors = <&zip_xy_scaler 4 3>;
};

&msc_input_listener {
    input-processors = <&zip_scroll_scaler 1 1>;
};
