## boards/shields/toucan_display/Kconfig.shield
```kconfig
config SHIELD_TOUCAN_DISPLAY
    def_bool $(shields_list_contains,toucan_display)
```

## boards/shields/toucan_dongle/Kconfig.defconfig
```kconfig
if SHIELD_TOUCAN_DONGLE

config ZMK_KEYBOARD_NAME
    default "Toucan"

config ZMK_SPLIT
    default y

config ZMK_SPLIT_ROLE_CENTRAL
    default y

endif
```

## boards/shields/toucan_left_peripheral/Kconfig.defconfig
```kconfig
if SHIELD_TOUCAN_LEFT_PERIPHERAL

config ZMK_KEYBOARD_NAME
    default "Toucan"

config ZMK_SPLIT
    default y

config SPI
    default y

endif
```

## boards/shields/toucan_left_peripheral/Kconfig.shield
```kconfig
config SHIELD_TOUCAN_LEFT_PERIPHERAL
    def_bool $(shields_list_contains,toucan_left_peripheral)
```

## config/west.yml
```yaml
manifest:
  remotes:
    # zmk official
    - name: zmkfirmware
      url-base: https://github.com/zmkfirmware
    # Urchin keeb
    - name: duckyb
      url-base: https://github.com/duckyb
    # Forager keeb
    - name: carrefinho
      url-base: https://github.com/carrefinho
    # Extra module for battery indicator
    - name: caksoylar
      url-base: https://github.com/caksoylar
    # Case mode behavior module
    - name: msmaili
      url-base: https://github.com/MSmaili
    # OS-aware shortcut module
    - name: mentaldesk
      url-base: https://github.com/mentaldesk
    # Toucan hardware, screen, and trackpad modules
    - name: toucan
      url-base: https://github.com/MuhametSmaili
    - name: beekeeb
      url-base: https://github.com/beekeeb
    # Halcyon dongle board
    - name: splitkb
      url-base: https://github.com/splitkb
  projects:
    - name: zmk
      remote: zmkfirmware
      revision: main
      import: app/west.yml
    - name: urchin-zmk-module
      remote: duckyb
      revision: main
    - name: forager-zmk-module
      remote: carrefinho
      revision: main
    - name: zmk-rgbled-widget
      remote: caksoylar
      revision: main
    - name: zmk-case-mode
      remote: msmaili
      revision: main
    - name: oskey
      remote: mentaldesk
      revision: main
    - name: zmk-keyboard-toucan2
      remote: toucan
      revision: main
    - name: zmk_driver_azoteq
      remote: beekeeb
      revision: main
    - name: zmk-input-zoom
      remote: beekeeb
      revision: main
    - name: zmk-halcyon-module
      remote: splitkb
      revision: main
  self:
    path: config
```

## dts/bindings/behaviors/zmk,behavior-toucan-status.yaml
```yaml
description: Internal Toucan2 screen status receiver over the existing split link
compatible: "zmk,behavior-toucan-status"
include: two_param.yaml
```
