## config/custom_os_module/Kconfig
```kconfig
config ZMK_OS_MODULE
    bool "Enable ZMK OS-dependent key behavior module"
    default y
    help
      Enables OS-aware behaviors for switching OS mode and sending OS-dependent keycodes.
```

## config/custom_os_module/dts/bindings/behaviors/zmk,behavior-os-kp.yaml
```yaml
description: ZMK behavior for OS-dependent key presses

compatible: "zmk,behavior-os-kp"

include: base.yaml

properties:
  label:
    type: string
  "#binding-cells":
    type: int
    const: 2
  default:
    type: string
    enum:
      - "linux"
      - "mac"
    default: "linux"
    description: |
      Determines parameter ordering:
      - "linux": param1=Linux keycode, param2=Mac keycode
      - "mac": param1=Mac keycode, param2=Linux keycode
```

## config/custom_os_module/dts/bindings/behaviors/zmk,behavior-set-os.yaml
```yaml
description: ZMK behavior for switching OS mode

compatible: "zmk,behavior-set-os"

include: base.yaml

properties:
  label:
    type: string
  "#binding-cells":
    type: int
    const: 1
```
